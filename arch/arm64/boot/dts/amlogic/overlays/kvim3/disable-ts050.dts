/dts-v1/;
/plugin/;

/ {
    fragment@0 {
        target = 
    }

	fragment@1 {
        target = <&hdmi_tx>;

        __overlay__ {
            status = "okay";
        };
    };

    fragment@2 {
        target = <&mipi_dsi>;

        __overlay__ {
            status = "disabled";
        };
    };

    fragment@3 {
        target = <&mipi_analog_dphy>;
    
        __overlay__ {
	        status = "disabled";
        };
    };

    fragment@4 {
        target = <&mipi_dphy>; 

        __overlay__ {
	        status = "disabled";
        };
    };
};